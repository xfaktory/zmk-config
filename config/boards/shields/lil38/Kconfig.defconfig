## config/boards/shields/lil38/Kconfig.defconfig
```kconfig
if SHIELD_LIL_38

# Name must be less than 16 characters long!
config ZMK_KEYBOARD_NAME
    default "Lil 38"

endif
```

## config/boards/shields/lil43/Kconfig.defconfig
```kconfig
if SHIELD_LIL_43

# Name must be less than 16 characters long!
config ZMK_KEYBOARD_NAME
    default "Lil 43"

endif
```

## config/boards/shields/lil43/Kconfig.shield
```kconfig
# No whitespace after the comma or in your keyboard name!
config SHIELD_LIL_43
    def_bool $(shields_list_contains,lil43)
```
